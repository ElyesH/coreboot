## src/cpu/intel/model_f6x/Kconfig
```kconfig
config CPU_INTEL_MODEL_F6X
	bool
	select ARCH_X86
	select SSE2
	select SUPPORT_CPU_UCODE_IN_CBFS
```

## src/mainboard/intel/dh67bl/Kconfig
```kconfig
## SPDX-License-Identifier: GPL-2.0-or-later

if BOARD_INTEL_DH67BL

config BOARD_SPECIFIC_OPTIONS
	def_bool y
	select BOARD_ROMSIZE_KB_4096
	select HAVE_ACPI_RESUME
	select HAVE_ACPI_TABLES
	select INTEL_INT15
	select MAINBOARD_HAS_LIBGFXINIT
	select NORTHBRIDGE_INTEL_SANDYBRIDGE
	select SERIRQ_CONTINUOUS_MODE
	select SOUTHBRIDGE_INTEL_BD82X6X
	select USE_NATIVE_RAMINIT
#	select superio Winbond W83677HG-i

config MAINBOARD_DIR
	string
	default "intel/dh67bl"

config MAINBOARD_PART_NUMBER
	string
	default "DH67BL"

config VGA_BIOS_ID
	string
	default "8086,0102"

config USBDEBUG_HCD_INDEX
	int
	default 2
endif
```

## src/mainboard/intel/dh67bl/Kconfig.name
```kconfig
## SPDX-License-Identifier: GPL-2.0-or-later

config BOARD_INTEL_DH67BL
	bool "DH67BL"
```

## src/mainboard/nec/945g-m4/Kconfig
```kconfig
if BOARD_NEC_945G_M4

config BOARD_SPECIFIC_OPTIONS
	def_bool y
	select CPU_INTEL_SOCKET_LGA775
	select NORTHBRIDGE_INTEL_I945
	select NORTHBRIDGE_INTEL_SUBTYPE_I945GC
	select SOUTHBRIDGE_INTEL_I82801GX
	select SUPERIO_WINBOND_W83627EHG
	select HAVE_OPTION_TABLE
	select HAVE_CMOS_DEFAULT
	select HAVE_MP_TABLE
	select HAVE_ACPI_TABLES
	select HAVE_ACPI_RESUME
	select BOARD_ROMSIZE_KB_512
	#select MAINBOARD_HAS_NATIVE_VGA_INIT
	select BOOT_DEVICE_NOT_SPI_FLASH

config MAINBOARD_DIR
	default "nec/945g-m4"

config MAINBOARD_PART_NUMBER
	default "945G-M4"

endif # BOARD_NEC_945G_M4
```

## src/mainboard/nec/Kconfig
```kconfig
if VENDOR_NEC

choice
	prompt "Mainboard model"

source "src/mainboard/nec/*/Kconfig.name"

endchoice

source "src/mainboard/nec/*/Kconfig"

config MAINBOARD_VENDOR
	string
	default "NEC"

endif # VENDOR_NEC
```
